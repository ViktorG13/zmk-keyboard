#include <dt-bindings/zmk/matrix_transform.h>

/ {
	chosen {
		zmk,kscan = &kscan0;
		zmk,matrix-transform = &default_transform;
	};
	
	default_transform: matrix_transform {
		compatible = "zmk,matrix-transform";
		
		rows = <1>;
		columns = <9>;
		
		map = <
		RC(0,0) RC(0,1) RC(0,2) RC(0,3) RC(0,4) RC(0,5) RC(0,6) RC(0,7) RC(0,8)
		>;
	};
};